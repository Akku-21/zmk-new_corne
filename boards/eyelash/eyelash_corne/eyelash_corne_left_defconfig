## boards/eyelash/eyelash_corne/eyelash_corne_left_defconfig
```kconfig
#
# Copyright (c) 2024 The ZMK Contributors
# SPDX-License-Identifier: MIT
#

CONFIG_PINCTRL=y

CONFIG_GPIO=y

CONFIG_SPI=y

CONFIG_BUILD_OUTPUT_UF2=y
CONFIG_MPU_ALLOW_FLASH_WRITE=y
CONFIG_NVS=y
CONFIG_SETTINGS_NVS=y
CONFIG_FLASH=y
CONFIG_FLASH_PAGE_LAYOUT=y
CONFIG_FLASH_MAP=y

CONFIG_ZMK_BLE=y

CONFIG_ZMK_EXT_POWER=y

CONFIG_WARN_DEPRECATED=n
```

## boards/eyelash/eyelash_corne/eyelash_corne_right_defconfig
```kconfig
#
# Copyright (c) 2024 The ZMK Contributors
# SPDX-License-Identifier: MIT
#

# enable pinctrl
CONFIG_PINCTRL=y

# enable GPIO
CONFIG_GPIO=y

# Enable SPI
CONFIG_SPI=y

# Enable writing to flash
CONFIG_BUILD_OUTPUT_UF2=y
CONFIG_MPU_ALLOW_FLASH_WRITE=y
CONFIG_NVS=y
CONFIG_SETTINGS_NVS=y
CONFIG_FLASH=y
CONFIG_FLASH_PAGE_LAYOUT=y
CONFIG_FLASH_MAP=y

CONFIG_ZMK_USB=n
CONFIG_ZMK_BLE=y

CONFIG_ZMK_EXT_POWER=y

CONFIG_WARN_DEPRECATED=n
```
